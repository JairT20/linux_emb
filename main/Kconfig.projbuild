## main/Kconfig.projbuild
```kconfig
menu "App config"

config APP_WIFI_SSID
string "Wi-Fi SSID"
default "TU_SSID"

config APP_WIFI_PASS
string "Wi-Fi Password"
default "TU_PASSWORD"

config APP_MQTT_URI
string "MQTT Broker URI (e.g. mqtt://192.168.1.50:1883)"
default "mqtt://192.168.1.50:1883"

endmenu
```

## sdkconfig.defaults
```kconfig
CONFIG_APP_WIFI_SSID="Hj"
CONFIG_APP_WIFI_PASS="12345678"
CONFIG_APP_MQTT_URI="mqtt://192.168.211.28:1883"
```
